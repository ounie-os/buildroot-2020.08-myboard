## package/python-aiofiles/Config.in
```kconfig
config BR2_PACKAGE_PYTHON_AIOFILES
	bool "python-aiofiles"
	depends on BR2_PACKAGE_PYTHON3
```

## package/python-httptools/Config.in
```kconfig
config BR2_PACKAGE_PYTHON_HTTPTOOLS
	bool "python-httptools"
	depends on BR2_PACKAGE_PYTHON3
```

## package/python-sanic-routing/Config.in
```kconfig
config BR2_PACKAGE_PYTHON_SANIC_ROUTING
	bool "python-sanic-routing"
	depends on BR2_PACKAGE_PYTHON3
```

## package/python-sanic/Config.in
```kconfig
config BR2_PACKAGE_PYTHON_SANIC
	bool "python-sanic"
	select BR2_PACKAGE_PYTHON_CLICK # runtime
	select BR2_PACKAGE_PYTHON_JINJA2 # runtime
	select BR2_PACKAGE_PYTHON_WERKZEUG # runtime
	select BR2_PACKAGE_PYTHON_ITSDANGEROUS # runtime
	select BR2_PACKAGE_PYTHON_SETUPTOOLS # runtime
	select BR2_PACKAGE_PYTHON_SANIC_ROUTING # runtime
	select BR2_PACKAGE_PYTHON_HTTPTOOLS
	select BR2_PACKAGE_PYTHON_AIOFILES
    select BR2_PACKAGE_PYTHON_MULTIDICT
	select BR2_PACKAGE_PYTHON_UJSON
	select BR2_PACKAGE_PYTHON_WEBSOCKETS
	select BR2_PACKAGE_PYTHON_UVLOOP
	select BR2_PACKAGE_PYTHON_SSL if BR2_PACKAGE_PYTHON
	select BR2_PACKAGE_PYTHON3_SSL if BR2_PACKAGE_PYTHON3
	select BR2_PACKAGE_PYTHON_ZLIB if BR2_PACKAGE_PYTHON
	select BR2_PACKAGE_PYTHON3_ZLIB if BR2_PACKAGE_PYTHON3
```
